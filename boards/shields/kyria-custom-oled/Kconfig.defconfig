## boards/shields/kyria-custom-oled/Kconfig.defconfig
```kconfig
if SHIELD_KYRIA_CUSTOM_OLED_LEFT

  config ZMK_KEYBOARD_NAME
    default "Kyria"

  config ZMK_SPLIT_ROLE_CENTRAL
    default y

  if ZMK_DISPLAY
    config ZMK_DISPLAY_STATUS_SCREEN_CUSTOM
      select ZMK_WPM
  endif # ZMK_DISPLAY

endif # SHIELD_KYRIA_CUSTOM_OLED_LEFT

if SHIELD_KYRIA_CUSTOM_OLED_LEFT || SHIELD_KYRIA_CUSTOM_OLED_RIGHT

  config ZMK_SPLIT
    default y

  if ZMK_DISPLAY

  config ZMK_DONGLE_DISPLAY_DONGLE_BATTERY
    bool "Show also the battery level of the dongle"
    depends on BT && (!ZMK_SPLIT_BLE || ZMK_SPLIT_ROLE_CENTRAL)

  config ZMK_DISPLAY_STATUS_SCREEN_CUSTOM
    select LV_USE_LABEL
    select LV_USE_IMG
    select LV_USE_CANVAS
    select LV_USE_ANIMIMG
    select LV_USE_ANIMATION
    select LV_USE_LINE
    select LV_FONT_UNSCII_8

  choice ZMK_DISPLAY_WORK_QUEUE
    default ZMK_DISPLAY_WORK_QUEUE_DEDICATED
  endchoice

  config I2C
    default y

  config SSD1306
    default y

  endif # ZMK_DISPLAY

  if LVGL

  config LV_Z_MEM_POOL_SIZE
    default 8192

  config LV_Z_VDB_SIZE
    default 64

  config LV_DPI_DEF
    default 148

  config LV_Z_BITS_PER_PIXEL
    default 1

  choice LV_COLOR_DEPTH
    default LV_COLOR_DEPTH_1
  endchoice

  endif # LVGL

endif
```

## boards/shields/kyria-custom-oled/Kconfig.shield
```kconfig
config SHIELD_KYRIA_CUSTOM_OLED_LEFT
  def_bool $(shields_list_contains,kyria_custom_oled_left)

config SHIELD_KYRIA_CUSTOM_OLED_RIGHT
  def_bool $(shields_list_contains,kyria_custom_oled_right)
```
